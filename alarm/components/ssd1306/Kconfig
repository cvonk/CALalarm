## alarm/components/ssd1306/Kconfig
```kconfig
menu "SSD1306 Configuration"

	config SSD1306_GPIO_RANGE_MAX
		int
		default 33 if IDF_TARGET_ESP32
		default 46 if IDF_TARGET_ESP32S2
		default 19 if IDF_TARGET_ESP32C3
		default 48 if IDF_TARGET_ESP32S3

	choice SSD1306_INTERFACE
		prompt "Interface"
		default SSD1306_I2C_INTERFACE
		help
			Select Interface.
		config SSD1306_I2C_INTERFACE
			bool "I2C Interface"
			help
				I2C Interface.
		config SSD1306_SPI_INTERFACE
			bool "SPI Interface"
			help
				SPI Interface.
	endchoice

	choice SSD1306_PANEL
		prompt "Panel Type"
		default SSD1306_128x64
		help
			Select Panel Type.
		config SSD1306_SSD1306_128x32
			bool "128x32 Panel"
			help
				Panel is 128x32.
		config SSD1306_SSD1306_128x64
			bool "128x64 Panel"
			help
				Panel is 128x64.
	endchoice

	config SSD1306_OFFSETX
		int "GRAM X OFFSET"
		range 0 99
		default 0
		help
			When your TFT have offset(X), set it.

	config SSD1306_FLIP
		bool "Flip upside down"
		default false
		help
			Flip upside down.

	config SSD1306_SCL_GPIO
		depends on SSD1306_I2C_INTERFACE
		int "SCL GPIO number"
		range 0 SSD1306_GPIO_RANGE_MAX
		default 22 if IDF_TARGET_ESP32
		default 12 if IDF_TARGET_ESP32S2
		default 12 if IDF_TARGET_ESP32S3
		default  9 if IDF_TARGET_ESP32C3
		help
			GPIO number (IOxx) to I2C SCL.
			Some GPIOs are used for other purposes (flash connections, etc.) and cannot be used to I2C.
			GPIOs 35-39 are input-only so cannot be used as outputs.

	config SSD1306_SDA_GPIO
		depends on SSD1306_I2C_INTERFACE
		int "SDA GPIO number"
		range 0 SSD1306_GPIO_RANGE_MAX
		default 21 if IDF_TARGET_ESP32
		default 11 if IDF_TARGET_ESP32S2
		default 11 if IDF_TARGET_ESP32S3
		default 10 if IDF_TARGET_ESP32C3
		help
			GPIO number (IOxx) to I2C SDA.
			Some GPIOs are used for other purposes (flash connections, etc.) and cannot be used to I2C.
			GPIOs 35-39 are input-only so cannot be used as outputs.

	config SSD1306_RESET_GPIO
		int "RESET GPIO number"
		range -1 SSD1306_GPIO_RANGE_MAX
		default 33 if IDF_TARGET_ESP32
		default 38 if IDF_TARGET_ESP32S2
		default 38 if IDF_TARGET_ESP32S3
		default  3 if IDF_TARGET_ESP32C3
		help
			GPIO number (IOxx) to RESET.
			When it is -1, RESET isn't performed.
			Some GPIOs are used for other purposes (flash connections, etc.) and cannot be used to Reset.
			GPIOs 35-39 are input-only so cannot be used as outputs.

	config SSD1306_MOSI_GPIO
		depends on SSD1306_SPI_INTERFACE
		int "MOSI GPIO number"
		range 0 SSD1306_GPIO_RANGE_MAX
		default 23 if IDF_TARGET_ESP32
		default 35 if IDF_TARGET_ESP32S2
		default 35 if IDF_TARGET_ESP32S3
		default  0 if IDF_TARGET_ESP32C3
		help
			GPIO number (IOxx) to SPI MOSI.
			Some GPIOs are used for other purposes (flash connections, etc.) and cannot be used to DC.
			On the ESP32, GPIOs 35-39 are input-only so cannot be used as outputs.
			On the ESP32-S2, GPIO 46 is input-only so cannot be used as outputs.

	config SSD1306_SCLK_GPIO
		depends on SSD1306_SPI_INTERFACE
		int "SCLK GPIO number"
		range 0 SSD1306_GPIO_RANGE_MAX
		default 18 if IDF_TARGET_ESP32
		default 36 if IDF_TARGET_ESP32S2
		default 36 if IDF_TARGET_ESP32S3
		default  1 if IDF_TARGET_ESP32C3
		help
			GPIO number (IOxx) to SPI SCLK.
			Some GPIOs are used for other purposes (flash connections, etc.) and cannot be used to DC.
			On the ESP32, GPIOs 35-39 are input-only so cannot be used as outputs.
			On the ESP32-S2, GPIO 46 is input-only so cannot be used as outputs.

	config SSD1306_CS_GPIO
		depends on SSD1306_SPI_INTERFACE
		int "CS GPIO number"
		range 0 SSD1306_GPIO_RANGE_MAX
		default  5 if IDF_TARGET_ESP32
		default 34 if IDF_TARGET_ESP32S2
		default 34 if IDF_TARGET_ESP32S3
		default 10 if IDF_TARGET_ESP32C3
		help
			GPIO number (IOxx) to SPI CS.
			Some GPIOs are used for other purposes (flash connections, etc.) and cannot be used to CS.
			GPIOs 35-39 are input-only so cannot be used as outputs.

	config SSD1306_DC_GPIO
		depends on SSD1306_SPI_INTERFACE
		int "DC GPIO number"
		range 0 SSD1306_GPIO_RANGE_MAX
		default 27 if IDF_TARGET_ESP32
		default 37 if IDF_TARGET_ESP32S2
		default 37 if IDF_TARGET_ESP32S3
		default  2 if IDF_TARGET_ESP32C3
		help
			GPIO number (IOxx) to SPI DC.
			Some GPIOs are used for other purposes (flash connections, etc.) and cannot be used to DC.
			GPIOs 35-39 are input-only so cannot be used as outputs.

endmenu
```

## alarm/main/Kconfig.example
```kconfig
menu "CALalarm"

    config OTA_UPDATE_FIRMWARE_URL
        string "Firmware upgrade url endpoint"
        default "http://host.domain/path/to/alarm.bin"
        help
            URL of server which hosts the firmware image. (make sure it matches Kconfig in factory dir)

    config OTA_UPDATE_RECV_TIMEOUT
        int "OTA Update receive Timeout"
        default 5000
        help
            Maximum time for reception [sec]

    config CALALARM_PHOTO3V_PIN
        int "GPIO# from PHOTO3V transistor"
        default 34
        help
            GPIO pin on ESP32 that connects from the PHOTO3V transistor.

    config CALALARM_ALARM_OFF_PIN
        int "GPIO# to ALARM_OFF button"
        default 32
        help
            GPIO pin on ESP32 that connects from the ALARM_OFF button.

    config CALALARM_PIEZO3V_PIN
        int "GPIO# to PIEZO3V transistor"
        default 27
        help
            GPIO pin on ESP32 that connects to the PIEZO3V transistor.

    config CALALARM_HAPTIC3V_PIN
        int "GPIO# to HAPTIC3V transistor"
        default 12
        help
            GPIO pin on ESP32 that connects to the HAPTIC3V transistor.

    config CALALARM_GAS_CALENDAR_URL
        string "Google script uri"
        default "https://script.google.com/macros/s/YOUR_UNIQUE_ID/exec"
        help
            Public URL of the Google Apps script that supplies JSON of the
            calendar events.

    config CALALARM_GAS_INTERVAL
        int "Polling interval for Google Apps Script"
        default 12
        help
            Number of minutes between polling the calendar events using Google Apps Script.
            When using push notifications this can be as high as e.g. 60 minutes.

    config CALALARM_HARDCODED_WIFI_CREDENTIALS
        bool "Use hardcoded Wi-Fi credentials"
        default n
        help
            Use a hardcoded Wi-Fi credentials. Defaults to n for BLE provisioning.
            
    config CALALARM_HARDCODED_WIFI_SSID
        string "WiFi SSID"
        default ""
        depends on CALALARM_HARDCODED_WIFI_CREDENTIALS
        help
            SSID (network name).

    config CALALARM_HARDCODED_WIFI_PASSWD
        string "WiFi Password"
        default ""
        depends on CALALARM_HARDCODED_WIFI_CREDENTIALS
        help
            WiFi password (WPA or WPA2).

endmenu
```

## clock/main/Kconfig
```kconfig
menu "OPNclock"

    config OTA_UPDATE_FIRMWARE_URL
        string "Firmware upgrade url endpoint"
        default "http://coertvonk.com/svonk/opnclock/clock.bin"
        help
            URL of server which hosts the firmware image. (make sure it matches Kconfig in factory dir)

    config OTA_UPDATE_RECV_TIMEOUT
        int "OTA Update receive Timeout"
        default 5000
        help
            Maximum time for reception [sec]

    config OPNCLOCK_WS2812_PIN
        int "GPIO# to WS2812 DATA"
        default 18
        help
            Transmit GPIO pin on ESP32 that connects to DATA on the LED circle

    config OPNCLOCK_WS2812_COUNT
        int "Number of LEDs"
        default 60
        help
            Number of WS2812 pixels on LED circle

    config OPNCLOCK_GAS_CALENDAR_URL
        string "Google script uri"
        default "https://script.google.com/macros/s/AKfycbxaQcijstlZ23vdOd1aZedh0fOU9_E4z6zXEBrpmXmI8pevFTV-cK0CfgLlXeYg5t_WQg/exec"
        help
            Public URL of the Google Apps script that supplies JSON of the
            calendar events.

    config OPNCLOCK_GAS_INTERVAL
        int "Polling interval for Google Apps Script"
        default 2
        help
            Number of minutes between polling the calendar events using Google Apps Script.
            When using push notifications this can be as high as e.g. 60 minutes.

    config OPNCLOCK_MQTT_DATA_TOPIC
        string "MQTT data topic"
        default "opnclock/data"
        help
            MQTT topic for data messages from the ESP32

    config OPNCLOCK_MQTT_CTRL_TOPIC
        string "MQTT control topic"
        default "opnclock/ctrl"
        help
            MQTT topic for ctrl messages to the ESP32

    config OPNCLOCK_HARDCODED_WIFI_CREDENTIALS
        bool "Use hardcoded Wi-Fi credentials"
        default n
        help
            Use a hardcoded Wi-Fi credentials. Defaults to n for BLE provisioning.
            
    config OPNCLOCK_HARDCODED_WIFI_SSID
        string "WiFi SSID"
        default ""
        depends on OPNCLOCK_HARDCODED_WIFI_CREDENTIALS
        help
            SSID (network name).

    config OPNCLOCK_HARDCODED_WIFI_PASSWD
        string "WiFi Password"
        default ""
        depends on OPNCLOCK_HARDCODED_WIFI_CREDENTIALS
        help
            WiFi password (WPA or WPA2).

    config OPNCLOCK_HARDCODED_MQTT_CREDENTIALS
        bool "Use hardcoded MQTT URL"
        default n
        help
            Use a hardcoded MQTT credentials. Defaults to n for BLE provisioning.
            
    config OPNCLOCK_HARDCODED_MQTT_URL
        string "Hardcoded MQTT broker url endpoint"
        default "mqtt://mqtt:passwd@host.domain:1883"
        depends on OPNCLOCK_HARDCODED_MQTT_CREDENTIALS
        help
            Hardcoded MQTT_URL. E.g. mqtt://mqtt:passwd@host.domain:1883.        
        
endmenu
```

## clock/main/Kconfig.example
```kconfig
menu "CALclock"

    config OTA_UPDATE_FIRMWARE_URL
        string "Firmware upgrade url endpoint"
        default "http://host:80/path/to/clock.bin"
        help
            URL of server which hosts the firmware image. (make sure it matches Kconfig in factory dir)

    config OTA_UPDATE_RECV_TIMEOUT
        int "OTA Update receive Timeout"
        default 5000
        help
            Maximum time for reception [sec]

    config CALCLOCK_WS2812_PIN
        int "GPIO# to WS2812 DATA"
        default 18
        help
            Transmit GPIO pin on ESP32 that connects to DATA on the LED circle

    config CALCLOCK_WS2812_COUNT
        int "Number of LEDs"
        default 60
        help
            Number of WS2812 pixels on LED circle

    config CALCLOCK_GAS_CALENDAR_URL
        string "Google script uri"
        default "https://script.google.com/macros/s/YOUR_UNIQ_KEY/exec"
        help
            Public URL of the Google Apps script that supplies JSON of the
            calendar events.

    config CALCLOCK_GAS_INTERVAL
        int "Polling interval for Google Apps Script"
        default 2
        help
            Number of minutes between polling the calendar events using Google Apps Script.
            When using push notifications this can be as high as e.g. 60 minutes.

    config CALCLOCK_MQTT_DATA_TOPIC
        string "MQTT data topic"
        default "calclock/data"
        help
            MQTT topic for data messages from the ESP32

    config CALCLOCK_MQTT_CTRL_TOPIC
        string "MQTT control topic"
        default "calclock/ctrl"
        help
            MQTT topic for ctrl messages to the ESP32

    config CALCLOCK_HARDCODED_WIFI_CREDENTIALS
        bool "Use hardcoded Wi-Fi credentials"
        default n
        help
            Use a hardcoded Wi-Fi credentials. Defaults to n for BLE provisioning.
            
    config CALCLOCK_HARDCODED_WIFI_SSID
        string "WiFi SSID"
        default ""
        depends on CALCLOCK_HARDCODED_WIFI_CREDENTIALS
        help
            SSID (network name).

    config CALCLOCK_HARDCODED_WIFI_PASSWD
        string "WiFi Password"
        default ""
        depends on CALCLOCK_HARDCODED_WIFI_CREDENTIALS
        help
            WiFi password (WPA or WPA2).

    config CALCLOCK_HARDCODED_MQTT_CREDENTIALS
        bool "Use hardcoded MQTT URL"
        default n
        help
            Use a hardcoded MQTT credentials. Defaults to n for BLE provisioning.
            
    config CALCLOCK_HARDCODED_MQTT_URL
        string "Hardcoded MQTT broker url endpoint"
        default "mqtt://mqtt:passwd@host.domain:1883"
        depends on CALCLOCK_HARDCODED_MQTT_CREDENTIALS
        help
            Hardcoded MQTT_URL. E.g. mqtt://mqtt:passwd@host.domain:1883.        
        
endmenu
```

## components/ota_task/Kconfig
```kconfig
menu "OTA Updates"

config OTA_FIRMWARE_URL
    string "firmware upgrade url endpoint"
    default "http://nas.vonk:83/embedded/calendarclock.bin"
    help
        URL of server which hosts the firmware
        image.
endmenu

config OTA_RECV_TIMEOUT
    int "OTA Receive Timeout"
    default 5000
    help
        Maximum time for reception
```

## components/reset_task/Kconfig
```kconfig
menu "Clock - RESET"

config CLOCK_RESET_PIN
    int "RESET GPIO# on ESP32"
    default 0
    help
        RESET input GPIO# on ESP32 that connects to a pull down switch

config CLOCK_RESET_SECONDS
    int "RESET press duration"
    default 3
    help
        Number of seconds that RESET needs to be hold low before erasing WiFi credentials

endmenu
```

## factory/main/Kconfig
```kconfig
menu "CalendarClock"

    config OTA_UPDATE_FIRMWARE_URL
        string "Firmware upgrade url endpoint"
        default "http://coertvonk.com/svonk/calclock/clock.bin"
        help
            URL of server which hosts the firmware image. (make sure it matches Kconfig in clock dir)

    config OTA_UPDATE_RECV_TIMEOUT
        int "OTA Update receive Timeout"
        default 5000
        help
            Maximum time for reception [sec]

endmenu
```

## factory/main/Kconfig.example
```kconfig
menu "CALclock"

    config OTA_UPDATE_FIRMWARE_URL
        string "Firmware upgrade url endpoint"
        default "http://host:80/path/to/clock.bin"
        help
            URL of server which hosts the firmware image. (make sure it matches Kconfig in clock dir)

    config OTA_UPDATE_RECV_TIMEOUT
        int "OTA Update receive Timeout"
        default 5000
        help
            Maximum time for reception [sec]

endmenu
```

## main/Kconfig
```kconfig
menu "Clock - main"

    config CLOCK_WS2812_PIN
        int "GPIO# to WS2812 DATA"
        default 18
        help
            Transmit GPIO pin on ESP32 that connects to DATA on the LED circle

    config CLOCK_WS2812_COUNT
        int "Number of LEDs"
        default 60
        help
            Number of WS2812 pixels on LED circle

    config CLOCK_GAS_CALENDAR_URL
        string "Google script uri"
        default "https://script.google.com/macros/s/AKfycbxBse1Ogq2OsaYxejVOn05hqmeyA5aM2Xpb3wem0b38bhWt9C6e/exec"
        help
            Public URL of the Google Apps script that supplies JSON of the
            calendar events.

endmenu
```
